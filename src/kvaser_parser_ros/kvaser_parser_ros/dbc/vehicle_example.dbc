VERSION "HIPBNYYYYYYYYYYYYYYYYYYYYYYYYYYYYYYYYYYYYY/4/%%%/4/'%**4YYY///"

NS_ :

BS_:

BU_:

BO_ 151 VehicleXb: 8 Vector__XXX
 SG_ time m0 : 0|32@1- (1,0) [0|1e+30] "s" Vector__XXX
 SG_ Xb m0 : 32|32@1- (1,0) [-1e+30|1e+30] "m" Vector__XXX

BO_ 152 VehicleYb: 8 Vector__XXX
 SG_ time m0 : 0|32@1- (1,0) [0|1e+30] "s" Vector__XXX
 SG_ Yb m0 : 32|32@1- (1,0) [-1e+30|1e+30] "m" Vector__XXX

BO_ 153 VehicleYaw: 8 Vector__XXX
 SG_ time m0 : 0|32@1- (1,0) [0|1e+30] "s" Vector__XXX
 SG_ Yaw m0 : 32|32@1- (1,0) [-1e+30|1e+30] "rad" Vector__XXX

BA_DEF_  "BusType" STRING ;
BA_DEF_DEF_  "BusType" "";
BA_ "BusType" "CAN";
SIG_VALTYPE_ 151 time : 1;
SIG_VALTYPE_ 151 Xb : 1;
SIG_VALTYPE_ 152 time : 1;
SIG_VALTYPE_ 152 Yb : 1;
SIG_VALTYPE_ 153 time : 1;
SIG_VALTYPE_ 153 Yaw : 1;
