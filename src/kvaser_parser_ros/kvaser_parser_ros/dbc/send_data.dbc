VERSION "HIPBNYYYYYYYYYYYYYYYYYYYYYYYYYYYYYYYYYYYYY/4/%%%/4/'%**4YYY///"

NS_ :

BS_:

BU_:

BO_ 100 Steering: 8 Vector__XXX
 SG_ Sttime m0 : 0|32@1- (1,0) [0|1e+30] "s" Vector__XXX
 SG_ StAngle m0 : 32|32@1- (1,0) [-1e+30|1e+30] "deg" Vector__XXX

BO_ 101 Speed: 8 Vector__XXX
 SG_ Sptime m0 : 0|32@1- (1,0) [0|1e+30] "s" Vector__XXX
 SG_ VehicleVx m0 : 32|32@1- (1,0) [-1e+30|1e+30] "km/h" Vector__XXX

BA_DEF_  "BusType" STRING ;
BA_DEF_DEF_  "BusType" "";
BA_ "BusType" "CAN";
SIG_VALTYPE_ 100 Sttime : 1;
SIG_VALTYPE_ 100 StAngle : 1;
SIG_VALTYPE_ 101 Sptime : 1;
SIG_VALTYPE_ 101 VehicleVx : 1;
